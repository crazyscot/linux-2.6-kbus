## ipc/Kconfig
```kconfig
config KBUS
        tristate "KBUS messaging system"
        default m
        ---help---
	KBUS is a lightweight messaging system, particularly aimed
	at embedded platforms. This option provides the kernel support
	for mediating messages between client processes.

	If you want KBUS support, you should say Y here.

	This support can also be built as a module. If so, the module
	will be called kbus.

if KBUS

config KBUS_DEBUG
	bool "Make KBUS debugging messages available"
	default y
	---help---
	This is the master switch for KBUS debug kernel messages -
	if turned off, all debug messages will be compiled out.

	In order for debugging messages to be emitted, they must
	be enabled per-device with the KBUS_IOC_VERBOSE ioctl,
	or by default by CONFIG_KBUS_DEBUG_DEFAULT_VERBOSE.

	If unsure, say Y.

config KBUS_DEBUG_DEFAULT_VERBOSE
	bool "Output KBUS debug messages by default"
	depends on KBUS_DEBUG
	default n
	---help---
	This switch is the default setting for whether KBUS devices will
	emit debugging messages. Note that debug messages may be turned
	on and off per-device at runtime with the KBUS_IOC_VERBOSE ioctl.

	If unsure, say N.

config KBUS_DEF_NUM_DEVICES
	int "Number of KBUS devices to auto-create"
	default 1
	range 1 KBUS_MAX_NUM_DEVICES
	---help---
	This specifies the number of KBUS devices that will be automatically
	created when the kbus subsystem initialises (when the module is
	is loaded or the kernel booted, as appropriate).

	If kbus is built as a module, this number may also be given as a
	parameter, for example kbus_num_devices=5.

config KBUS_MAX_NUM_DEVICES
	int "Maximum number of KBUS devices"
	default 256
	range 1 2147483647
	# We don't impose a limit on the max, so if you've got enough
	# RAM the only practical limit will be the (int) minor count
	# passed to __register_chrdev_region.
	---help---
	Specify the maximum number of KBUS devices to support.
	Note that this setting controls the size of an array of pointers
	to in-kernel kbus structs; reducing it only saves a tiny amount
	of RAM.

config KBUS_DEF_MAX_MESSAGES
	int "Default KBUS message queue size limit"
	default 100
	range 1 2147483647
	---help---
	Specify the default recipient message queue size limit.
	This default is applied to all recipients (clients) whenever they
	open or reopen a KBUS device node.

	Clients sending messages may specify their desired behaviour in
	the event that any of the recipient(s)' message queues is full;
	if a sender's own queue is full, it may not send a message
	flagged as a Request.  Refer to the documentation ("Queues filling
	up") for details.

	Clients may change their own queue size limits at any time with the
	KBUS_IOC_MAXMSGS ioctl.

config KBUS_MAX_UNSENT_UNBIND_MESSAGES
	int "Maximum number of unsent KBUS unbind event messages"
	default 1000
	range 1 2147483647
	---help---
	KBUS devices may request (by ioctl) that they want to receive
	notifications when listeners unbind. If such a notification happens
	at a time when the device's message queue is full, it is instead
	saved internally and delivered later. This setting limits the number
	of messages which may be queued internally in that way; if the
	limit is reached, a special "there were more unbind events than
	we were able to deliver" message is queued for that listener,
	and no more internal events are sent to them until that message
	has been delivered.

endif # KBUS
```
